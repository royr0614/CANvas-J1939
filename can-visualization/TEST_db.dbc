VERSION ""

NS_ :

BS_:

BU_:

BO_ 2533178121 Msg1: 8 A
 SG_ signal2 : 8|8@1- (1,0) [0|0] "" Vector__XXX
 SG_ signal1 : 0|8@1- (10,2) [0|0] "" Vector__XXX

BA_DEF_  "ProtocolType" STRING ;
BA_DEF_ BO_  "VFrameFormat" INT;
BA_DEF_ BO_  "GenMsgCycleTime" INT 0 65535;
BA_DEF_DEF_  "ProtocolType" "J1939";
BA_DEF_DEF_  "VFrameFormat" 3;
BA_DEF_DEF_  "GenMsgCycleTime" 0;
BA_ "GenMsgCycleTime" BO_ 2533178121 50;
